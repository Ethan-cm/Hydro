
 /*
 * Copyright (c) 2021 Nordic Semiconductor ASA
 * SPDX-License-Identifier: Apache-2.0
 */

/* This devicetree overlay file will be automatically picked by the Zephyr
 * build system when building the sample for the nucleo_f302r8 board. It shows
 * how the example-application can be built on sample boards already provided
 * by Zephyr.
 */

/ {
	lcd0: lcd_0 {
		compatible = "zephyr,lcd";
		label = "LCD_0";
		output-gpios = <&gpiod 13 GPIO_ACTIVE_HIGH>;
	};
};

&gpiod {
	status = "okay";
};

/ {
	dht11 {
		compatible = "aosong,dht";
		status = "okay";
		label = "DHT11";
		dio-gpios = <&gpiod 7 (GPIO_PULL_UP | GPIO_ACTIVE_LOW)>;
		/*leaving dht22 unset to signify DHT11 */
	};
};

